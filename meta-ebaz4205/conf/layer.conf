## meta-ebaz4205/conf/layer.conf
```bitbake
# We have a conf and classes directory, add to BBPATH.
BBPATH .= ":${LAYERDIR}"

# Add recipes and recipe append files to BitBake's search path.
BBFILES += "${LAYERDIR}/recipes-*/*/*.bb \
            ${LAYERDIR}/recipes-*/*/*.bbappend"

BBFILE_COLLECTIONS += "ebaz4205"
BBFILE_PATTERN_ebaz4205 = "^${LAYERDIR}/"
BBFILE_PRIORITY_ebaz4205 = "7"

LAYERSUMMARY_ebaz4205 = "Ebang EBAZ4205 Zynq-7000 BSP"
LAYERDESCRIPTION_ebaz4205 = "Board support for the Ebang EBAZ4205, including SD boot through U-Boot SPL."

LAYERDEPENDS_ebaz4205 = "core xilinx"
LAYERSERIES_COMPAT_ebaz4205 = "scarthgap"
```

## meta-ebaz4205/conf/machine/ebaz4205-zynq7.conf
```bitbake
#@TYPE: Machine
#@NAME: ebaz4205-zynq7
#@DESCRIPTION: Ebang EBAZ4205 (XC7Z010, 256 MiB DDR3), booting from microSD.

require conf/machine/zynq-generic.conf

# Keep the reusable downloads and shared-state caches outside the checkout.
# These hard assignments are version-controlled as part of this machine; a
# developer can still override them later from build/conf/local.conf if needed.
DL_DIR = "${HOME}/edf202601-cache/downloads"
SSTATE_DIR = "${HOME}/edf202601-cache/sstate-cache/arm"

# Strict offline mode.  EDF normally adds its HTTPS source and sstate mirrors
# from build/conf/local.conf; machine overrides keep this board reproducible
# from the two local caches above and prevent fallback to any network URL.
# BB_NO_NETWORK:ebaz4205-zynq7 = "1"
INHERIT:remove:ebaz4205-zynq7 = "own-mirrors"
SOURCE_MIRROR_URL:ebaz4205-zynq7 = ""
SSTATE_MIRRORS:ebaz4205-zynq7 = ""

# U-Boot SPL is the BootROM image and performs the board-specific PS/DDR init.
SPL_BINARY = "spl/boot.bin"
PREFERRED_PROVIDER_virtual/boot-bin = "u-boot-xlnx"

# SPL loads the full U-Boot image from the first FAT partition.
UBOOT_SUFFIX = "img"
UBOOT_BINARY = "u-boot.img"
UBOOT_MACHINE = "xilinx_zynq_virt_defconfig"
UBOOT_USER_SPECIFIED_DTS = "zynq-ebaz4205"
FORCE_PLATFORM_INIT = "1"

# The board's UART header J7 is UART1 on MIO 24/25.
SERIAL_CONSOLES = "115200;ttyPS0"

# Linux keeps the Xilinx 32-bit ARM device trees in a vendor subdirectory.
KERNEL_DEVICETREE = "xilinx/zynq-ebaz4205.dtb"

# Zynq boot-mode value 5 is SD. Force boot.bin into all generated SD images;
# this machine deliberately uses SPL instead of the Xilinx FSBL/bootgen flow.
DEFAULT_HW_BOOT_MODE = "5"
SOC_ON_DISK_BOOT_BIN = "1"

# zynq-generic already adds uImage and boot.scr. Add both stages needed by SPL.
IMAGE_BOOT_FILES += "boot.bin u-boot.img"

# EDF uses a three-partition layout and only copies this explicit list into
# partition 1. The kernel remains in /boot on rootfs partition 3.
EDF_DISTROBOOT_ESP_FILES = "boot.bin u-boot.img boot.scr"

MACHINE_FEATURES = "ext2 ext3 vfat"

# The generic EDF disk image is valid for this Cortex-A9 machine.  Register it
# with EDF's advisory image check so do_rootfs does not emit an unsupported
# machine warning.
AMD-EDF_IMAGE_SUPPORTED_MACHINES:append = " ebaz4205-zynq7"

# 最多同时执行BitBake任务数
BB_NUMBER_THREADS = "8"
# 每个BitBake任务最多同时执行的编译任务数
BB_NUMBER_PARSE_THREADS = "4"
# 每个编译任务最多同时执行的make任务数
PARALLEL_MAKE = "-j 4"
# 每个BitBake任务最多同时执行的make install任务数
PARALLEL_MAKEINST = "-j 4"
```
